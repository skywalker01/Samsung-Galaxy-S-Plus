## drivers/net/wireless/bcm4329/Kconfig
```kconfig
config BROADCOM_WIFI
	default m
	tristate "Broadcom 4329 wireless cards support"
	depends on MMC
	select WIRELESS_EXT
	select WEXT_PRIV
	---help---
	  This module adds support for wireless adapters based on
	  Broadcom 4329 chipset.

	  This driver uses the kernel's wireless extensions subsystem.

	  If you choose to build a module, it'll be called dhd. Say M if
	  unsure.

config BROADCOM_WIFI_RESERVED_MEM
    bool "Samsung Multimedia Devices"
    depends on BROADCOM_WIFI
    default n
    ---help---
      This is a configuration for broadcom WLAN driver.

if BROADCOM_WIFI_RESERVED_MEM
config WLAN_SAMSUNG_MEMSIZE_BCM
    int "Memory size in kbytes for WLAN driver"
    default "256"
endif

config BCM4329_FW_PATH
	depends on BROADCOM_WIFI
	string "Firmware path"
	default "/system/etc/firmware/fw_bcm4329.bin"
	---help---
	  Path to the firmware file.

config BCM4329_NVRAM_PATH
	depends on BROADCOM_WIFI
	string "NVRAM path"
	default "/proc/calibration"
	---help---
	  Path to the calibration file.
```
